// SPDX-License-Identifier: GPL-2.0-or-later
/*
 * OVT OP2200H dual-PCIe test image.
 *
 * This is deliberately separate from the normal milestone-1 DTS. It still
 * has no NAND node and its image profile still emits initramfs only. Hardware
 * differences from milestone-1: recovered dual-controller PCIe, and the CPU
 * GMAC + on-chip switch enabled for the two copper LAN jacks only (switch
 * ports 0 and 1). GPON/PON is not described here. The driver leaves eth0
 * down until opened by hand; do not bake a MAC.
 */

/dts-v1/;

#include "rtl9607c.dtsi"
#include "rtl9607c_ovt_op2200h-common.dtsi"

/ {
	model = "OVT OP2200H (dual-PCIe test)";
	realtek,enable-pcie;
};

&nic {
	status = "okay";
};
